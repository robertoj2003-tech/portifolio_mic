/*
 * main.c
 *
 * Created: 5/29/2026 4:41:31 PM
 *  Author: Robert
 */ 


///MEDIR A TENSAO DE UMA BATERIA, E ACENDER UM LED AMARELO  SE ELA ESTIVER ABAIXO DE 3V, E UM VERMELHO SE ESTIVER ACIMA DE 3,8V(EM CARREGAMENTO)
//OBS: BATERIA NO PINO ADC7, USAR VRED=AVCC(5V)
#include <xc.h>
#define  F_CPU 16000000
int main(void)
{
	ADMUX = (0<<REFS1)|(1<<REFS0)   //UTILIZAR VREF=AVCC(5V)
	    | (0<<MUX3)|(1<<MUX2)|(1<<MUX1)|(1<<MUX0);  //BATERIA NO PINO ADC7
	ADCSRA = (1<<ADEN)|(0<<ADATE)//LIGAR ADC, MODO SINGLE CONVERSION
	      |  (0<<ADIE) // DESABILITAR INTERRUPÇÃO
           | (1<<ADPS2)| (1<<ADPS1)| (1<<ADPS0); //PRESCALER=128 (FADC=125KHZ, SAMPLING RATE DE 9615 SPS)
	ADCSRB = 0 ; // IGNORAR, NAO ESTAMOS USANDO AUTO TRIGGER
	DIDR0 = 0; // IGNORAR, NAO ESTAMOS USANDO PORTAS ADC0-ADC5
	
	DDRB = (1<<DDB2)(1<<DDB1)|(1<<DDB0);
    while(1)
    {
        ADCSRA |= (1<<ADSC); // DISPARAR CONVERSAO
		while(ADCSRA & (1<<ADSC)); //ESPERAR CONCLUSAO, ADSC RETORNA SOZINHO E VAI PRA 0
		uint16_t tResult = ADC; // ARMAZENAR RESULTADO NA VARIAVEL
		
		PORTB=0; // AAPAGA LED
		if(tResult< 614){ //n= (2^10) * (3v*5v)
			PORTB |= (1<<PORTB0);
		}else
		if (tResult>778){//n= (2^10) * (3.8v*5v)
			PORTB |= (1<<PORTB2);
		}else{
		PORTB |= (1<<PORTB1);
		}
    }
}